## config/components/efuse/test_apps/sdkconfig.defaults
```kconfig
CONFIG_APP_REPRODUCIBLE_BUILD=y
# CONFIG_APP_COMPILE_TIME_DATE is not set
# General options for additional checks
CONFIG_HEAP_POISONING_COMPREHENSIVE=y
CONFIG_COMPILER_WARN_WRITE_STRINGS=y
CONFIG_FREERTOS_WATCHPOINT_END_OF_STACK=y
CONFIG_COMPILER_STACK_CHECK_MODE_STRONG=y
CONFIG_COMPILER_STACK_CHECK=y

CONFIG_ESP_TASK_WDT_INIT=n

CONFIG_EFUSE_VIRTUAL=y

# Required by the "Test token dump" test, which calls esp_efuse_token_dump()
# with the FROM_STAGED type. Without this option that call returns
# ESP_ERR_NOT_SUPPORTED and the test aborts while batch write mode is still
# enabled, leaving the batch flag stuck on and cascading failures into all
# later efuse tests that burn and read back.
CONFIG_EFUSE_ENABLE_STAGED_TOKEN_API=y
```

## config/components/esp_driver_gptimer/test_apps/gptimer/sdkconfig.defaults
```kconfig
CONFIG_APP_REPRODUCIBLE_BUILD=y
# CONFIG_APP_COMPILE_TIME_DATE is not set
# CONFIG_ESP_TASK_WDT_INIT is not set
CONFIG_FREERTOS_HZ=1000
# Disable nano printf, because we need to print the timer count in %llu format
CONFIG_NEWLIB_NANO_FORMAT=n

# primitives for checking sleep internal state
CONFIG_ESP_SLEEP_DEBUG=y
```

## config/components/esp_driver_i2s/test_apps/i2s/sdkconfig.defaults
```kconfig
CONFIG_APP_REPRODUCIBLE_BUILD=y
# CONFIG_APP_COMPILE_TIME_DATE is not set
CONFIG_I2S_ENABLE_DEBUG_LOG=y
CONFIG_ESP_TASK_WDT_EN=n
```

## config/components/esp_driver_ledc/test_apps/ledc/sdkconfig.defaults
```kconfig
CONFIG_APP_REPRODUCIBLE_BUILD=y
# CONFIG_APP_COMPILE_TIME_DATE is not set
CONFIG_FREERTOS_HZ=1000
CONFIG_ESP_TASK_WDT_INIT=n
# Disable memory protection, because "LEDC continue work after software reset" test case requires a cpu reset
CONFIG_ESP_SYSTEM_MEMPROT_FEATURE=n
```

## config/components/esp_driver_usb_serial_jtag/test_apps/usb_serial_jtag/sdkconfig.defaults
```kconfig
CONFIG_APP_REPRODUCIBLE_BUILD=y
# CONFIG_APP_COMPILE_TIME_DATE is not set
CONFIG_FREERTOS_HZ=1000
CONFIG_ESP_TASK_WDT_INIT=n
CONFIG_ESP_CONSOLE_USB_SERIAL_JTAG=y
```

## config/components/esp_hal_security/test_apps/crypto/sdkconfig.defaults
```kconfig
CONFIG_UNITY_ENABLE_FIXTURE=y
CONFIG_APP_REPRODUCIBLE_BUILD=y
# CONFIG_APP_COMPILE_TIME_DATE is not set

# Custom partition table with storage partition (required for key_manager tests)
CONFIG_PARTITION_TABLE_CUSTOM=y
CONFIG_PARTITION_TABLE_CUSTOM_FILENAME="partitions.csv"
CONFIG_PARTITION_TABLE_FILENAME="partitions.csv"
CONFIG_PARTITION_TABLE_OFFSET=0x8000
```

## config/components/esp_hw_support/test_apps/dma/sdkconfig.defaults
```kconfig
CONFIG_APP_REPRODUCIBLE_BUILD=y
# CONFIG_APP_COMPILE_TIME_DATE is not set
CONFIG_FREERTOS_HZ=1000
CONFIG_ESP_TASK_WDT_EN=n
CONFIG_IDF_EXPERIMENTAL_FEATURES=y
```

## config/components/esp_system/test_apps/esp_system_unity_tests/sdkconfig.defaults
```kconfig
CONFIG_APP_REPRODUCIBLE_BUILD=y
# CONFIG_APP_COMPILE_TIME_DATE is not set
# CONFIG_TASK_WDT is not set
```

## config/components/esp_wifi/test_apps/wifi_function/sdkconfig.defaults
```kconfig
CONFIG_APP_REPRODUCIBLE_BUILD=y
# CONFIG_APP_COMPILE_TIME_DATE is not set
# ignore task watchdog triggered by unity_run_menu
CONFIG_ESP_TASK_WDT=n
```

## config/components/hal/test_apps/crypto/sdkconfig.defaults
```kconfig
CONFIG_UNITY_ENABLE_FIXTURE=y
CONFIG_APP_REPRODUCIBLE_BUILD=y
# CONFIG_APP_COMPILE_TIME_DATE is not set
```

## config/components/nvs_flash/test_apps/sdkconfig.defaults
```kconfig
CONFIG_APP_REPRODUCIBLE_BUILD=y
# CONFIG_APP_COMPILE_TIME_DATE is not set
CONFIG_BOOTLOADER_LOG_LEVEL_WARN=y
CONFIG_NVS_ASSERT_ERROR_CHECK=y

CONFIG_ESP_TASK_WDT_EN=y
CONFIG_ESP_TASK_WDT_INIT=n
```

## config/examples/get-started/hello_world/sdkconfig.defaults
```kconfig
CONFIG_APP_REPRODUCIBLE_BUILD=y
# CONFIG_APP_COMPILE_TIME_DATE is not set
CONFIG_ESP32P4_SELECTS_REV_LESS_V3=n
CONFIG_ESP32P4_REV_MIN=300
```

## config/examples/peripherals/usb/device/tusb_console/sdkconfig.defaults
```kconfig
CONFIG_APP_REPRODUCIBLE_BUILD=y
# CONFIG_APP_COMPILE_TIME_DATE is not set
CONFIG_TINYUSB_CDC_ENABLED=y
```

## config/examples/peripherals/usb_serial_jtag/usb_serial_jtag_echo/sdkconfig.defaults
```kconfig
CONFIG_APP_REPRODUCIBLE_BUILD=y
# CONFIG_APP_COMPILE_TIME_DATE is not set
CONFIG_ESP_CONSOLE_SECONDARY_NONE=y
```

## config/examples/wifi/getting_started/station/sdkconfig.defaults
```kconfig
CONFIG_APP_REPRODUCIBLE_BUILD=y
CONFIG_ESP_WIFI_SSID="Wokwi-GUEST"
CONFIG_ESP_WIFI_PASSWORD=""
CONFIG_ESP_WIFI_AUTH_OPEN=y
CONFIG_ESP_WIFI_SOFTAP_SUPPORT=n
```

## config/examples/wifi/getting_started/station/sdkconfig.defaults.esp32p4
```kconfig
# ESP32-P4 Function EV Board uses ESP-Hosted for WiFi via on-board ESP32-C6 coprocessor
# The C6 is connected via SDIO slot 1 with these GPIOs:
#   CLK=18, CMD=19, D0=14, D1=15, D2=16, D3=17, RESET=54
CONFIG_ESP_HOSTED_P4_DEV_BOARD_FUNC_BOARD=y
CONFIG_ESP_HOSTED_SDIO_HOST_INTERFACE=y
CONFIG_ESP_HOSTED_SDIO_OPTIMIZATION_RX_STREAMING_MODE=y

# Disable task watchdog for testing
CONFIG_ESP_TASK_WDT_EN=n
```
